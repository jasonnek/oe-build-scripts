## conf/bblayers.conf
```bitbake
LCONF_VERSION = "5"
BBPATH = "${TOPDIR}"
BBFILES ?= ""
BBLAYERS = " \
    ${TOPDIR}/oe-core/meta \
    ${TOPDIR}/meta-oe/meta-oe \
    ${TOPDIR}/meta-oe/meta-networking \
    ${TOPDIR}/meta-virtualization \
    ${TOPDIR}/meta-intel \
    ${TOPDIR}/meta-intel/meta-sugarbay \
    ${TOPDIR}/meta-integral \
"
```

## conf/local.conf
```bitbake
BB_NUMBER_THREADS = "16"
PARALLEL_MAKE = "-j 16"

MACHINE ?= "sugarbay"
DISTRO="oe-hype-ndvm"

DL_DIR = "/mnt/openembedded/downloads" 
SSTATE_DIR ?= "${TOPDIR}/sstate-cache"
TMPDIR = "${TOPDIR}/tmp"
PACKAGE_CLASSES ?= "package_ipk"
EXTRA_IMAGE_FEATURES = "debug-tweaks"
USER_CLASSES ?= "buildstats image-mklibs image-prelink"
PATCHRESOLVE = "noop"
CONF_VERSION = "1"
BBFILE_PRIORITY_hype = "8"
```
